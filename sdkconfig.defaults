## sdkconfig.defaults
```kconfig
# JFBMS sdkconfig.defaults - preserved from IDF v5 sdkconfig
# IDF v6 will regenerate sdkconfig from these defaults

# Target
CONFIG_IDF_TARGET="esp32c3"

# Partition table
CONFIG_PARTITION_TABLE_CUSTOM=y
CONFIG_PARTITION_TABLE_CUSTOM_FILENAME="partition_ota.csv"
CONFIG_PARTITION_TABLE_FILENAME="partition_ota.csv"
CONFIG_PARTITION_TABLE_OFFSET=0x8000

# Flash
CONFIG_ESPTOOLPY_FLASHMODE_QIO=y
CONFIG_ESPTOOLPY_FLASHFREQ_80M=y
CONFIG_ESPTOOLPY_FLASHSIZE_4MB=y

# Compiler
CONFIG_COMPILER_OPTIMIZATION_PERF=y
CONFIG_COMPILER_OPTIMIZATION_ASSERTIONS_SILENT=y

# Bootloader
CONFIG_BOOTLOADER_COMPILER_OPTIMIZATION_PERF=y
CONFIG_BOOTLOADER_LOG_LEVEL_NONE=y
CONFIG_BOOTLOADER_SKIP_VALIDATE_IN_DEEP_SLEEP=y
CONFIG_BOOTLOADER_SKIP_VALIDATE_ON_POWER_ON=y

# Logging
CONFIG_LOG_DEFAULT_LEVEL_NONE=y

# Console - disabled (no UART console)
CONFIG_ESP_CONSOLE_NONE=y

# Bluetooth
CONFIG_BT_ENABLED=y
CONFIG_BT_BLUEDROID_ENABLED=y
CONFIG_BT_CONTROLLER_ENABLED=y
CONFIG_BT_BTC_TASK_STACK_SIZE=3072
CONFIG_BT_BTU_TASK_STACK_SIZE=2048
CONFIG_BT_BLE_ENABLED=y
CONFIG_BT_GATTS_ENABLE=y
CONFIG_BT_GATT_MAX_SR_PROFILES=4
CONFIG_BT_GATT_MAX_SR_ATTRIBUTES=20
CONFIG_BT_GATTS_SEND_SERVICE_CHANGE_AUTO=y
CONFIG_BT_BLE_SMP_ENABLE=y
CONFIG_BT_BLE_SMP_BOND_NVS_FLASH=y
CONFIG_BT_STACK_NO_LOG=y
CONFIG_BT_ACL_CONNECTIONS=3
CONFIG_BT_BLE_DYNAMIC_ENV_MEMORY=y
CONFIG_BT_SMP_ENABLE=y
CONFIG_BT_SMP_MAX_BONDS=15
CONFIG_BT_MAX_DEVICE_NAME_LEN=32
CONFIG_BT_BLE_50_FEATURES_SUPPORTED=y
CONFIG_BT_BLE_50_EXTEND_ADV_EN=y
CONFIG_BT_BLE_50_PERIODIC_ADV_EN=y
CONFIG_BT_BLE_50_EXTEND_SCAN_EN=y
CONFIG_BT_BLE_50_EXTEND_SYNC_EN=y
CONFIG_BT_BLE_42_FEATURES_SUPPORTED=y
CONFIG_BT_BLE_42_ADV_EN=y
CONFIG_BT_BLE_42_SCAN_EN=y
CONFIG_BT_CTRL_BLE_MAX_ACT=2
CONFIG_BT_CTRL_HCI_MODE_VHCI=y
CONFIG_BT_CTRL_BLE_ADV_REPORT_FLOW_CTRL_SUPP=y
CONFIG_BT_CTRL_BLE_ADV_REPORT_FLOW_CTRL_NUM=100
CONFIG_BT_CTRL_BLE_ADV_REPORT_DISCARD_THRSHOLD=20
CONFIG_BT_CTRL_DTM_ENABLE=y
CONFIG_BT_CTRL_BLE_MASTER=y
CONFIG_BT_CTRL_BLE_SCAN=y
CONFIG_BT_CTRL_BLE_SECURITY_ENABLE=y
CONFIG_BT_CTRL_BLE_ADV=y

# WiFi
CONFIG_ESP_WIFI_ENABLED=y
CONFIG_ESP_WIFI_STATIC_RX_BUFFER_NUM=3
CONFIG_ESP_WIFI_DYNAMIC_RX_BUFFER_NUM=6
CONFIG_ESP_WIFI_STATIC_TX_BUFFER=y
CONFIG_ESP_WIFI_STATIC_TX_BUFFER_NUM=3
CONFIG_ESP_WIFI_ENABLE_WPA3_SAE=y
CONFIG_ESP_WIFI_SOFTAP_SUPPORT=y
CONFIG_ESP_WIFI_SW_COEXIST_ENABLE=y

# TWAI (CAN)
CONFIG_TWAI_ISR_IN_IRAM=y
CONFIG_TWAI_SUPPRESS_DEPRECATE_WARN=y

# I2C - suppress legacy driver deprecation (used by BQ76952 code)
CONFIG_I2C_SUPPRESS_DEPRECATE_WARN=y

# FreeRTOS
CONFIG_FREERTOS_UNICORE=y
CONFIG_FREERTOS_HZ=1000
CONFIG_FREERTOS_GENERATE_RUN_TIME_STATS=y

# System
CONFIG_ESP_MAIN_TASK_STACK_SIZE=3072

# LWIP
CONFIG_LWIP_MAX_SOCKETS=5
CONFIG_LWIP_SO_REUSE=y
CONFIG_LWIP_TCP_MSS=1024
CONFIG_LWIP_TCP_SND_BUF_DEFAULT=2440
CONFIG_LWIP_TCP_WND_DEFAULT=2440
CONFIG_LWIP_MAX_RAW_PCBS=16
```
